## CMakeLists.txt
```
cmake_minimum_required(VERSION 3.20.0)
find_package(Zephyr REQUIRED HINTS $ENV{ZEPHYR_BASE})
project(zenoh_sub)

file(GLOB app_sources src/*.c)
set(common_sources ${CMAKE_CURRENT_SOURCE_DIR}/../common/src/atomic_shim.c
                   ${CMAKE_CURRENT_SOURCE_DIR}/../common/src/ipv4_dhcp_client.c)
target_sources(app PRIVATE ${app_sources} ${common_sources})
target_include_directories(
  app PRIVATE ${CMAKE_CURRENT_SOURCE_DIR}/../common/include)

if(DEFINED ENV{ZENOH_LOCATOR} AND NOT "$ENV{ZENOH_LOCATOR}" STREQUAL "")
  target_compile_definitions(app PRIVATE ZENOH_LOCATOR=\"$ENV{ZENOH_LOCATOR}\")
  message(STATUS "zenoh_sub: ZENOH_LOCATOR is set from environment")
endif()
```

## prj.conf
```kconfig
CONFIG_NETWORKING=y
CONFIG_NET_IPV6=y
CONFIG_NET_IPV4=y
CONFIG_NET_ARP=y
CONFIG_NET_TCP=y
CONFIG_NET_UDP=y
CONFIG_NET_SOCKETS=y
CONFIG_NET_DHCPV4=y
CONFIG_NET_DHCPV4_OPTION_CALLBACKS=y
CONFIG_DNS_RESOLVER=y

CONFIG_ENTROPY_GENERATOR=y
CONFIG_TEST_RANDOM_GENERATOR=y

CONFIG_INIT_STACKS=y

CONFIG_NET_MGMT=y
CONFIG_NET_MGMT_EVENT=y

CONFIG_NET_LOG=y
CONFIG_LOG=y

CONFIG_SLIP_STATISTICS=n
CONFIG_NET_SHELL=y

# Added config for zenoh-pico
## ref: https://github.com/eclipse-zenoh/zenoh-pico/blob/1.8.0/zephyr/Kconfig.zenoh
CONFIG_ZENOH_PICO=y
CONFIG_ZENOH_PICO_MULTI_THREAD=y
CONFIG_ZENOH_PICO_PUBLICATION=y
CONFIG_ZENOH_PICO_SUBSCRIPTION=y
CONFIG_ZENOH_PICO_QUERY=y
CONFIG_ZENOH_PICO_QUERYABLE=y
CONFIG_ZENOH_PICO_LINK_TCP=y
CONFIG_ZENOH_PICO_SCOUTING=y
CONFIG_ZENOH_PICO_LINK_UDP_UNICAST=y
CONFIG_ZENOH_PICO_LINK_UDP_MULTICAST=y
## POSIX support is required by zenoh-pico Zephyr backend
CONFIG_POSIX_API=y
CONFIG_POSIX_THREADS=y
CONFIG_POSIX_THREADS_EXT=y
CONFIG_POSIX_TIMERS=y
CONFIG_POSIX_NETWORKING=y
## Resource size increases for zenoh-pico 
## ref: https://github.com/eclipse-zenoh/zenoh-pico/blob/1.8.0/docs/zephyr/nucleo_f767zi/prj.conf
### Stack and heap sizes
CONFIG_MAIN_STACK_SIZE=4096
CONFIG_SYSTEM_WORKQUEUE_STACK_SIZE=4096
CONFIG_HEAP_MEM_POOL_SIZE=150000
### Network buffers
CONFIG_NET_PKT_RX_COUNT=16
CONFIG_NET_PKT_TX_COUNT=16
CONFIG_NET_BUF_RX_COUNT=80
CONFIG_NET_BUF_TX_COUNT=80
CONFIG_NET_CONTEXT_NET_PKT_POOL=y
CONFIG_NET_MAX_CONTEXTS=10
### POSIX object pools
CONFIG_POSIX_THREAD_THREADS_MAX=4
CONFIG_MAX_PTHREAD_MUTEX_COUNT=32
CONFIG_MAX_PTHREAD_COND_COUNT=8
CONFIG_POSIX_THREAD_KEYS_MAX=8
```

## src/main.c
```c
#include <stdio.h>
#include <stdlib.h>
#include <string.h>
#include <zenoh-pico.h>
#include <zephyr/kernel.h>
#include <zephyr/logging/log.h>

#include "ipv4_dhcp_client.h"

LOG_MODULE_REGISTER(app, CONFIG_LOG_DEFAULT_LEVEL);

#define MODE "client"
#ifndef ZENOH_LOCATOR
#define ZENOH_LOCATOR ""
#endif
#define LOCATOR ZENOH_LOCATOR

#define KEYEXPR "demo/example/**"

static void data_handler(z_loaned_sample_t* sample, void* arg) {
  ARG_UNUSED(arg);

  z_view_string_t keystr;
  z_keyexpr_as_view_string(z_sample_keyexpr(sample), &keystr);
  z_owned_string_t value;
  z_bytes_to_string(z_sample_payload(sample), &value);

  LOG_INF("Received ('%.*s': '%.*s')", (int)z_string_len(z_loan(keystr)),
          z_string_data(z_loan(keystr)), (int)z_string_len(z_loan(value)),
          z_string_data(z_loan(value)));
  z_drop(z_move(value));
}

int main(void) {
  int rc = dhcpv4_wait_for_ipv4();
  if (rc != 0) {
    LOG_ERR("DHCPv4 failed (%d)", rc);
    return rc;
  }

  z_owned_config_t config;
  z_config_default(&config);
  zp_config_insert(z_loan_mut(config), Z_CONFIG_MODE_KEY, MODE);
  if (strcmp(LOCATOR, "") != 0) {
    LOG_INF("Using Zenoh locator from compile-time env: %s", LOCATOR);
    zp_config_insert(z_loan_mut(config), Z_CONFIG_CONNECT_KEY, LOCATOR);
  }

  LOG_INF("Opening Zenoh Session...");
  z_owned_session_t s;
  if (z_open(&s, z_move(config), NULL) < 0) {
    LOG_ERR("Unable to open session!");
    return -1;
  }
  LOG_INF("OK");

  zp_start_read_task(z_loan_mut(s), NULL);
  zp_start_lease_task(z_loan_mut(s), NULL);

  LOG_INF("Declaring subscriber on '%s'...", KEYEXPR);
  z_owned_closure_sample_t callback;
  z_closure(&callback, data_handler, NULL, NULL);
  z_view_keyexpr_t ke;
  z_view_keyexpr_from_str_unchecked(&ke, KEYEXPR);
  z_owned_subscriber_t sub;
  if (z_declare_subscriber(z_loan(s), &sub, z_loan(ke), z_move(callback),
                           NULL) < 0) {
    LOG_ERR("Unable to declare subscriber.");
    return -1;
  }
  LOG_INF("OK");

  while (1) {
    k_sleep(K_SECONDS(1));
  }

  LOG_INF("Closing Zenoh Session...");
  z_drop(z_move(sub));
  z_drop(z_move(s));
  LOG_INF("OK!");

  return 0;
}
```

## src/atomic_shim.c
```c
#include <stdbool.h>
#include <stdint.h>
#include <zephyr/kernel.h>

/*
 * Minimal 32-bit __atomic builtins for RV32IM without the RISC-V A extension.
 * This is acceptable for the current single-core VexRiscv/Zephyr setup.
 */

uint32_t __atomic_fetch_add_4(volatile void* ptr, uint32_t val, int memmodel) {
  ARG_UNUSED(memmodel);

  unsigned int key = irq_lock();
  uint32_t old = *(volatile uint32_t*)ptr;
  *(volatile uint32_t*)ptr = old + val;
  irq_unlock(key);

  return old;
}

uint32_t __atomic_fetch_sub_4(volatile void* ptr, uint32_t val, int memmodel) {
  ARG_UNUSED(memmodel);

  unsigned int key = irq_lock();
  uint32_t old = *(volatile uint32_t*)ptr;
  *(volatile uint32_t*)ptr = old - val;
  irq_unlock(key);

  return old;
}

bool __atomic_compare_exchange_4(volatile void* ptr, void* expected,
                                 uint32_t desired, bool weak,
                                 int success_memmodel, int failure_memmodel) {
  ARG_UNUSED(weak);
  ARG_UNUSED(success_memmodel);
  ARG_UNUSED(failure_memmodel);

  unsigned int key = irq_lock();

  uint32_t old = *(volatile uint32_t*)ptr;
  uint32_t exp = *(uint32_t*)expected;

  if (old == exp) {
    *(volatile uint32_t*)ptr = desired;
    irq_unlock(key);
    return true;
  }

  *(uint32_t*)expected = old;
  irq_unlock(key);
  return false;
}
```
