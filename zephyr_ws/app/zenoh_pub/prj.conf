## CMakeLists.txt
```
cmake_minimum_required(VERSION 3.20.0)
find_package(Zephyr REQUIRED HINTS $ENV{ZEPHYR_BASE})
project(zenoh_pub)

file(GLOB app_sources src/*.c)
set(common_sources ${CMAKE_CURRENT_SOURCE_DIR}/../common/src/atomic_shim.c
                   ${CMAKE_CURRENT_SOURCE_DIR}/../common/src/ipv4_dhcp_client.c)
target_sources(app PRIVATE ${app_sources} ${common_sources})
target_include_directories(
  app PRIVATE ${CMAKE_CURRENT_SOURCE_DIR}/../common/include)

if(DEFINED ENV{ZENOH_LOCATOR} AND NOT "$ENV{ZENOH_LOCATOR}" STREQUAL "")
  target_compile_definitions(app PRIVATE ZENOH_LOCATOR=\"$ENV{ZENOH_LOCATOR}\")
  message(STATUS "zenoh_pub: ZENOH_LOCATOR is set from environment")
endif()
```

## prj.conf
```kconfig
CONFIG_NETWORKING=y
CONFIG_NET_IPV6=y
CONFIG_NET_IPV4=y
CONFIG_NET_ARP=y
CONFIG_NET_TCP=y
CONFIG_NET_UDP=y
CONFIG_NET_SOCKETS=y
CONFIG_NET_DHCPV4=y
CONFIG_NET_DHCPV4_OPTION_CALLBACKS=y
CONFIG_DNS_RESOLVER=y

CONFIG_TEST_RANDOM_GENERATOR=y

CONFIG_INIT_STACKS=y

CONFIG_NET_MGMT=y
CONFIG_NET_MGMT_EVENT=y

CONFIG_NET_LOG=y
CONFIG_LOG=y

CONFIG_SLIP_STATISTICS=n
CONFIG_NET_SHELL=y

# Added config for zenoh-pico
## ref: https://github.com/eclipse-zenoh/zenoh-pico/blob/1.8.0/zephyr/Kconfig.zenoh
CONFIG_ZENOH_PICO=y
CONFIG_ZENOH_PICO_MULTI_THREAD=y
CONFIG_ZENOH_PICO_PUBLICATION=y
CONFIG_ZENOH_PICO_SUBSCRIPTION=y
CONFIG_ZENOH_PICO_QUERY=y
CONFIG_ZENOH_PICO_QUERYABLE=y
CONFIG_ZENOH_PICO_LINK_TCP=y
CONFIG_ZENOH_PICO_SCOUTING=y
CONFIG_ZENOH_PICO_LINK_UDP_UNICAST=y
CONFIG_ZENOH_PICO_LINK_UDP_MULTICAST=y
## POSIX support is required by zenoh-pico Zephyr backend
CONFIG_POSIX_API=y
CONFIG_POSIX_THREADS=y
CONFIG_POSIX_TIMERS=y
CONFIG_POSIX_NETWORKING=y
```

## src/main.c
```c
#include <stdio.h>
#include <stdlib.h>
#include <string.h>
#include <zenoh-pico.h>
#include <zephyr/kernel.h>
#include <zephyr/logging/log.h>

#include "ipv4_dhcp_client.h"

LOG_MODULE_REGISTER(app, CONFIG_LOG_DEFAULT_LEVEL);

#define MODE "client"
#ifndef ZENOH_LOCATOR
#define ZENOH_LOCATOR ""
#endif
#define LOCATOR ZENOH_LOCATOR

#define KEYEXPR "demo/example/zenoh-pico-pub"
#define VALUE "Pub from Zenoh-Pico!"

int main(void) {
  int rc = dhcpv4_wait_for_ipv4();
  if (rc != 0) {
    LOG_ERR("DHCPv4 failed (%d)", rc);
    return rc;
  }

  // Initialize Zenoh Session and other parameters
  z_owned_config_t config;
  z_config_default(&config);
  zp_config_insert(z_loan_mut(config), Z_CONFIG_MODE_KEY, MODE);
  if (strcmp(LOCATOR, "") != 0) {
    if (strcmp(MODE, "client") == 0) {
      LOG_INF("Using Zenoh locator from compile-time env: %s", LOCATOR);
      zp_config_insert(z_loan_mut(config), Z_CONFIG_CONNECT_KEY, LOCATOR);
    } else {
      zp_config_insert(z_loan_mut(config), Z_CONFIG_LISTEN_KEY, LOCATOR);
    }
  }

  // Open Zenoh session
  LOG_INF("Opening Zenoh Session...");
  z_owned_session_t s;
  if (z_open(&s, z_move(config), NULL) < 0) {
    LOG_ERR("Unable to open session!");
    return -1;
  }
  LOG_INF("OK");

  // Start the receive and the session lease loop for zenoh-pico
  zp_start_read_task(z_loan_mut(s), NULL);
  zp_start_lease_task(z_loan_mut(s), NULL);

  LOG_INF("Declaring publisher for '%s'...", KEYEXPR);
  z_view_keyexpr_t ke;
  z_view_keyexpr_from_str_unchecked(&ke, KEYEXPR);
  z_owned_publisher_t pub;
  if (z_declare_publisher(z_loan(s), &pub, z_loan(ke), NULL) < 0) {
    LOG_ERR("Unable to declare publisher for key expression!");
    return -1;
  }
  LOG_INF("OK");

  char buf[256];
  for (int idx = 0; 1; ++idx) {
    k_sleep(K_SECONDS(1));
    snprintk(buf, sizeof(buf), "[%4d] %s", idx, VALUE);
    LOG_INF("Putting Data ('%s': '%s')...", KEYEXPR, buf);

    // Create payload
    z_owned_bytes_t payload;
    z_bytes_copy_from_str(&payload, buf);

    z_publisher_put(z_loan(pub), z_move(payload), NULL);
  }

  LOG_INF("Closing Zenoh Session...");
  z_drop(z_move(pub));

  z_drop(z_move(s));
  LOG_INF("OK!");

  return 0;
}
```
