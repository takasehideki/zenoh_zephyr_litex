## zephyr_ws/manifest/west.yml
```yaml
manifest:
  projects:
    - name: zephyr
      url: https://github.com/zephyrproject-rtos/zephyr
      revision: v4.4.0
      path: zephyr
      clone-depth: 1
      west-commands: scripts/west-commands.yml

  self:
    path: manifest
    import: submanifests/zenoh-pico.yaml
```
